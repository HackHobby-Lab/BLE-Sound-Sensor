## Abdullah/Kconfig/Kconfig.shield
```kconfig
osource "e:/blesoundsensor/april/adc/boards/shields/*/Kconfig.shield"
osource "C:/ncs/v2.6.0/nrf/boards/shields/*/Kconfig.shield"
```

## Abdullah/Kconfig/Kconfig.shield.defconfig
```kconfig
osource "e:/blesoundsensor/april/adc/boards/shields/*/Kconfig.defconfig"
osource "C:/ncs/v2.6.0/nrf/boards/shields/*/Kconfig.defconfig"
```

## BLE_Version_4.0/Ics/build/Kconfig/boards/Kconfig.defconfig
```kconfig
# Load Zephyr board defconfig descriptions.
osource "C:/ncs/v3.2.4/zephyr/boards/nordic/nrf52833dk/Kconfig.defconfig"
```
